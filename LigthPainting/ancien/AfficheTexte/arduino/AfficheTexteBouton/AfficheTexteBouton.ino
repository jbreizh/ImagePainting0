// include the library code:
#include <Adafruit_NeoPixel.h>
#include <avr/pgmspace.h>
#define PIN            11  //Pin used for neopixels
#define BLOCS          7  //How many pixels square per metapixel?
#define NUMPIXELS      8  //How many metapixels your font is?
#define BUTTONPIN1     3  //Pin used for control button1
#define BUTTONPIN2     2  //Pin used for control button2

// initialize
Adafruit_NeoPixel pixels = Adafruit_NeoPixel(NUMPIXELS*BLOCS, PIN, NEO_GRB + NEO_KHZ800);

// constante
// alphabet
const byte fontA [192] PROGMEM = { 0, 0, 0, 0, 0, 0, 0, 0, 0, 0, 0, 0, 0,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 0, 0};
const byte fontB [192] PROGMEM = { 0, 0, 0, 0, 0, 0, 0, 0, 0, 0, 0, 0, 0,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 0, 0};
const byte fontC [192] PROGMEM = { 0, 0, 0, 0, 0, 0, 0, 0, 0, 0, 0, 0, 0,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 0, 0};
const byte fontD [192] PROGMEM = { 0, 0, 0, 0, 0, 0, 0, 0, 0, 0, 0, 0, 0,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 0, 0};
const byte fontE [192] PROGMEM = { 0, 0, 0, 0, 0, 0, 0, 0, 0, 0, 0, 0, 0,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 0, 0};
const byte fontF [192] PROGMEM = { 0, 0, 0, 0, 0, 0, 0, 0, 0, 0, 0, 0, 0,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 0, 0};
const byte fontG [192] PROGMEM = { 0, 0, 0, 0, 0, 0, 0, 0, 0, 0, 0, 0, 0,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 0, 0};
const byte fontH [192] PROGMEM = { 0, 0, 0, 0, 0, 0, 0, 0, 0, 0, 0, 0, 0,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 0, 0};
const byte fontI [192] PROGMEM = { 0, 0, 0, 0, 0, 0, 0, 0, 0, 0, 0, 0, 0,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 0, 0};
const byte fontJ [192] PROGMEM = { 0, 0, 0, 0, 0, 0, 0, 0, 0, 0, 0, 0, 0,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 0, 0};
const byte fontK [192] PROGMEM = { 0, 0, 0, 0, 0, 0, 0, 0, 0, 0, 0, 0, 0,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 0, 0};
const byte fontL [192] PROGMEM = { 0, 0, 0, 0, 0, 0, 0, 0, 0, 0, 0, 0, 0,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 0, 0};
const byte fontM [192] PROGMEM = { 0, 0, 0, 0, 0, 0, 0, 0, 0, 0, 0, 0, 0,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 255, 255};
const byte fontN [192] PROGMEM = { 0, 0, 0, 0, 0, 0, 0, 0, 0, 0, 0, 0, 0,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 0, 0};
const byte fontO [192] PROGMEM = { 0, 0, 0, 0, 0, 0, 0, 0, 0, 0, 0, 0, 0,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 0, 0};
const byte fontP [192] PROGMEM = { 0, 0, 0, 0, 0, 0, 0, 0, 0, 0, 0, 0, 0,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 0, 0};
const byte fontQ [192] PROGMEM = { 0, 0, 0, 0, 0, 0, 0, 0, 0, 0, 0, 0, 0,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 0, 0};
const byte fontR [192] PROGMEM = { 0, 0, 0, 0, 0, 0, 0, 0, 0, 0, 0, 0, 0,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 0, 0};
const byte fontS [192] PROGMEM = { 0, 0, 0, 0, 0, 0, 0, 0, 0, 0, 0, 0, 0,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 0, 0};
const byte fontT [192] PROGMEM = { 0, 0, 0, 0, 0, 0, 0, 0, 0, 0, 0, 0, 0,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 0, 0};
const byte fontU [192] PROGMEM = { 0, 0, 0, 0, 0, 0, 0, 0, 0, 0, 0, 0, 0,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 0, 0};
const byte fontV [192] PROGMEM = { 0, 0, 0, 0, 0, 0, 0, 0, 0, 0, 0, 0, 0,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 0, 0};
const byte fontW [192] PROGMEM = { 0, 0, 0, 0, 0, 0, 0, 0, 0, 0, 0, 0, 0,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 255, 255};
const byte fontX [192] PROGMEM = { 0, 0, 0, 0, 0, 0, 0, 0, 0, 0, 0, 0, 0,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 0, 0};
const byte fontY [192] PROGMEM = { 0, 0, 0, 0, 0, 0, 0, 0, 0, 0, 0, 0, 0,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 0, 0};
const byte fontZ [192] PROGMEM = { 0, 0, 0, 0, 0, 0, 0, 0, 0, 0, 0, 0, 0,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 0, 0};
const byte fontSpace [192] PROGMEM = { 0, 0, 0, 0, 0, 0, 0, 0, 0, 0, 0, 0, 0,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 0, 0};

// custom
const byte font1 [192] PROGMEM = { 0, 0, 0, 250, 189, 96, 250, 189, 96, 250, 189, 96, 250,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 0, 0};
const byte font2 [192] PROGMEM = { 0, 0, 0, 199, 210, 22, 199, 210, 22, 199, 210, 22, 199,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 0, 0};
const byte font3 [192] PROGMEM = { 0, 0, 0, 34, 186, 233, 34, 186, 233, 34, 186, 233, 34,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 0, 0};

const int length = NUMPIXELS * NUMPIXELS; //length of font array
const char message1[] = "AUDREY"; //message 1
const char message2[] = "FUCK"; //message 2

// variables
char character;  //character value
int characterl; //character location (in message)

int layer; //layer location
int blocH; //pixel location
int pixel; //pixel location
int blocV; //pixel location

int r;  //Red pixel value
int g;  //Green pixel value
int b;  //Blue pixel value
int rl; //Red pixel location (in array)
int gl; //Green pixel location (in array)
int bl; //Blue pixel location (in array)

// setup
void setup() {
  // button setup
  pinMode(BUTTONPIN1, INPUT);
  pinMode(BUTTONPIN2, INPUT);
  // serial (debug) setup
  pixels.begin();
  Serial.begin(9600);
  // neopixel setup
  pixels.setBrightness(20); // set the led brightness
  for (pixel = 0; pixel < (NUMPIXELS * BLOCS + 1) ; pixel = pixel + 1) {   //Turns off all pixels at the start
    pixels.setPixelColor(pixel , 0, 0, 0);
  }
  pixels.show();
}

//choose the right character
void chooseCharacter() {
  switch (character) {
    // alphabet
    case 'A':
      g = pgm_read_byte (fontA + gl);                               //Get current green colour value
      r = pgm_read_byte (fontA + rl);                               //Get current red colour value
      b = pgm_read_byte (fontA + bl);                               //Get current blue colour value
      break;
    case 'B':
      g = pgm_read_byte (fontB + gl);
      r = pgm_read_byte (fontB + rl);
      b = pgm_read_byte (fontB + bl);
      break;
    case 'C':
      g = pgm_read_byte (fontC + gl);
      r = pgm_read_byte (fontC + rl);
      b = pgm_read_byte (fontC + bl);
      break;
    case 'D':
      g = pgm_read_byte (fontD + gl);
      r = pgm_read_byte (fontD + rl);
      b = pgm_read_byte (fontD + bl);
      break;
    case 'E':
      g = pgm_read_byte (fontE + gl);
      r = pgm_read_byte (fontE + rl);
      b = pgm_read_byte (fontE + bl);
      break;
    case 'F':
      g = pgm_read_byte (fontF + gl);
      r = pgm_read_byte (fontF + rl);
      b = pgm_read_byte (fontF + bl);
      break;
    case 'G':
      g = pgm_read_byte (fontG + gl);
      r = pgm_read_byte (fontG + rl);
      b = pgm_read_byte (fontG + bl);
      break;
    case 'H':
      g = pgm_read_byte (fontH + gl);
      r = pgm_read_byte (fontH + rl);
      b = pgm_read_byte (fontH + bl);
      break;
    case 'I':
      g = pgm_read_byte (fontI + gl);
      r = pgm_read_byte (fontI + rl);
      b = pgm_read_byte (fontI + bl);
      break;
    case 'J':
      g = pgm_read_byte (fontJ + gl);
      r = pgm_read_byte (fontJ + rl);
      b = pgm_read_byte (fontJ + bl);
      break;
    case 'K':
      g = pgm_read_byte (fontK + gl);
      r = pgm_read_byte (fontK + rl);
      b = pgm_read_byte (fontK + bl);
      break;
    case 'L':
      g = pgm_read_byte (fontL + gl);
      r = pgm_read_byte (fontL + rl);
      b = pgm_read_byte (fontL + bl);
      break;
    case 'M':
      g = pgm_read_byte (fontM + gl);
      r = pgm_read_byte (fontM + rl);
      b = pgm_read_byte (fontM + bl);
      break;
    case 'N':
      g = pgm_read_byte (fontN + gl);
      r = pgm_read_byte (fontN + rl);
      b = pgm_read_byte (fontN + bl);
      break;
    case 'O':
      g = pgm_read_byte (fontO + gl);
      r = pgm_read_byte (fontO + rl);
      b = pgm_read_byte (fontO + bl);
      break;
    case 'P':
      g = pgm_read_byte (fontP + gl);
      r = pgm_read_byte (fontP + rl);
      b = pgm_read_byte (fontP + bl);
      break;
    case 'Q':
      g = pgm_read_byte (fontQ + gl);
      r = pgm_read_byte (fontQ + rl);
      b = pgm_read_byte (fontQ + bl);
      break;
    case 'R':
      g = pgm_read_byte (fontR + gl);
      r = pgm_read_byte (fontR + rl);
      b = pgm_read_byte (fontR + bl);
      break;
    case 'S':
      g = pgm_read_byte (fontS + gl);
      r = pgm_read_byte (fontS + rl);
      b = pgm_read_byte (fontS + bl);
      break;
    case 'T':
      g = pgm_read_byte (fontT + gl);
      r = pgm_read_byte (fontT + rl);
      b = pgm_read_byte (fontT + bl);
      break;
    case 'U':
      g = pgm_read_byte (fontU + gl);
      r = pgm_read_byte (fontU + rl);
      b = pgm_read_byte (fontU + bl);
      break;
    case 'V':
      g = pgm_read_byte (fontV + gl);
      r = pgm_read_byte (fontV + rl);
      b = pgm_read_byte (fontV + bl);
      break;
    case 'W':
      g = pgm_read_byte (fontW + gl);
      r = pgm_read_byte (fontW + rl);
      b = pgm_read_byte (fontW + bl);
      break;
    case 'X':
      g = pgm_read_byte (fontX + gl);
      r = pgm_read_byte (fontX + rl);
      b = pgm_read_byte (fontX + bl);
      break;
    case 'Y':
      g = pgm_read_byte (fontY + gl);
      r = pgm_read_byte (fontY + rl);
      b = pgm_read_byte (fontY + bl);
      break;
    case 'Z':
      g = pgm_read_byte (fontZ + gl);
      r = pgm_read_byte (fontZ + rl);
      b = pgm_read_byte (fontZ + bl);
      break;
    // custom
    case '1':
      g = pgm_read_byte (font1 + gl);
      r = pgm_read_byte (font1 + rl);
      b = pgm_read_byte (font1 + bl);
      break;
    case '2':
      g = pgm_read_byte (font2 + gl);
      r = pgm_read_byte (font2 + rl);
      b = pgm_read_byte (font2 + bl);
      break;
    case '3':
      g = pgm_read_byte (font3 + gl);
      r = pgm_read_byte (font3 + rl);
      b = pgm_read_byte (font3 + bl);
      break;
    default:
      g = pgm_read_byte (fontSpace + gl);
      r = pgm_read_byte (fontSpace + rl);
      b = pgm_read_byte (fontSpace + bl);
      break;
  }
}

// print the message
void printMessage(char message[], int messageSize) {
  Serial.print("message : ");
  Serial.println(message);
  Serial.print("size : ");
  Serial.println(messageSize);
  for (characterl = 0; characterl < messageSize - 1 ; characterl = characterl + 1) {
    character = message[characterl];
    Serial.print("character : ");
    Serial.println(character);
    for (layer = 0; layer < (length / NUMPIXELS); layer = layer + 1) {    //For each layer in the image
      for (blocH = 0; blocH < (BLOCS + 1) ; blocH = blocH + 1) {          //For each bloc Horizontal
        for (pixel = 0; pixel < (NUMPIXELS + 1) ; pixel = pixel + 1) {    //For each pixel
          gl = ((layer * (NUMPIXELS * 3)) + (pixel * 3) + 1);             //Get location of the current green pixel
          rl = ((layer * (NUMPIXELS * 3)) + (pixel * 3) + 0);             //Get location of the current red pixel
          bl = ((layer * (NUMPIXELS * 3)) + (pixel * 3) + 2);             //Get location of the current blue pixel
          chooseCharacter();
          for (blocV = 0; blocV < (BLOCS + 1) ; blocV = blocV + 1) {      //For each bloc Vertical
            pixels.setPixelColor(pixel * BLOCS + blocV , r, g, b);        //Set the pixel data
          }
        }
        pixels.show();
        delay(80);
      }
    }
  }
  Serial.println("cleaning...");
  for (pixel = 0; pixel < (NUMPIXELS * BLOCS + 1) ; pixel = pixel + 1) {   //Turns off all pixels at the end
    pixels.setPixelColor(pixel , 0, 0, 0);
  }
  pixels.show();
}

// loop
void loop() {
  if (digitalRead(BUTTONPIN1) == HIGH) {
    tone(8,2000,200);
    Serial.println("button 1 start");
    printMessage(message1, sizeof(message1));
    Serial.println("button 1 stop");
    tone(8,2000,200);
  }
  if (digitalRead(BUTTONPIN2) == HIGH) {
    tone(8,2000,200);
    Serial.println("button 2 start");
    printMessage(message2, sizeof(message2));
    Serial.println("button 2 stop");
    tone(8,2000,200);
  }
}
